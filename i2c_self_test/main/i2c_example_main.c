
#include <stdio.h>
#include "esp_log.h"
#include "driver/i2c.h"
#include "sdkconfig.h"
#include <string.h>

const char font8x8_basic[128][8] = {
    {0x00, 0x00, 0x00, 0x00, 0x00, 0x00, 0x00, 0x00}, // U+0000 (nul)
    {0x00, 0x00, 0x00, 0x00, 0x00, 0x00, 0x00, 0x00}, // U+0001
    {0x00, 0x00, 0x00, 0x00, 0x00, 0x00, 0x00, 0x00}, // U+0002
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    {0x00, 0x00, 0x00, 0x00, 0x00, 0x00, 0x00, 0x00}  // U+007F
};

char font16x16[128][32] = {
    {0x00, 0x00, 0x00, 0x00, 0x00, 0x00, 0x00, 0x00, 0x00, 0x00, 0x00, 0x00, 0x00, 0x00, 0x00, 0x00, 0x00, 0x00, 0x00, 0x00, 0x00, 0x00, 0x00, 0x00, 0x00, 0x00, 0x00, 0x00, 0x00, 0x00, 0x00, 0x00},
    {0x00, 0x00, 0x00, 0x00, 0xF8, 0x01, 0x08, 0x01, 0x08, 0x01, 0x08, 0x01, 0x08, 0x01, 0x08, 0x01, 0x08, 0x01, 0x08, 0x01, 0x08, 0x01, 0x08, 0x01, 0x08, 0x01, 0xF8, 0x01, 0x00, 0x00, 0x00, 0x00},
    {0x00, 0x00, 0x00, 0x00, 0xF8, 0x01, 0x08, 0x01, 0x08, 0x01, 0x08, 0x01, 0x08, 0x01, 0x08, 0x01, 0x08, 0x01, 0x08, 0x01, 0x08, 0x01, 0x08, 0x01, 0x08, 0x01, 0xF8, 0x01, 0x00, 0x00, 0x00, 0x00},
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    {0x00, 0x00, 0x00, 0x00, 0xF8, 0x01, 0x08, 0x01, 0x08, 0x01, 0x08, 0x01, 0x08, 0x01, 0x08, 0x01, 0x08, 0x01, 0x08, 0x01, 0x08, 0x01, 0x08, 0x01, 0x08, 0x01, 0xF8, 0x01, 0x00, 0x00, 0x00, 0x00}};

// Enumeration for screen colors
typedef enum
{
    Black = 0x00, // Black color, no pixel
    White = 0x0f  // Pixel is set. Color depends on OLED
} SSD1327_COLOR;

#define SSD1327_BUFFER_SIZE 8192

uint8_t SSD1327_Buffer[SSD1327_BUFFER_SIZE]; // Screenbuffer

#define I2C_ADDR 0x3C
#define DELAY_TIME_BETWEEN_ITEMS_MS 1000 /*!< delay time between different test items */

#define I2C_MASTER_SCL_IO 22 /*!< gpio number for I2C master clock */
#define I2C_MASTER_SDA_IO 21 /*!< gpio number for I2C master data  */

#define ACK_CHECK_EN 0x1  /*!< I2C master will check ack from slave*/
#define ACK_CHECK_DIS 0x0 /*!< I2C master will not check ack from slave */
#define ACK_VAL 0x0       /*!< I2C ack value */
#define NACK_VAL 0x1      /*!< I2C nack value */

#define COMM_MODE 0x00
#define DATA_MODE 0x40

SemaphoreHandle_t print_mux = NULL;

/**
 * @brief i2c master initialization
 */
static esp_err_t i2c_master_init(void)
{
    int i2c_master_port = I2C_NUM_0;
    i2c_config_t conf = {
        .mode = I2C_MODE_MASTER,
        .sda_io_num = I2C_MASTER_SDA_IO,
        .sda_pullup_en = GPIO_PULLUP_DISABLE,
        .scl_io_num = I2C_MASTER_SCL_IO,
        .scl_pullup_en = GPIO_PULLUP_DISABLE,
        .master.clk_speed = 1000000,
        //.clk_flags = I2C_SCLK_SRC_FLAG_FOR_NOMAL,          /*!< Optional, you can use I2C_SCLK_SRC_FLAG_* flags to choose i2c source clock here. */
    };
    esp_err_t err = i2c_param_config(i2c_master_port, &conf);
    if (err != ESP_OK)
    {
        return err;
    }
    return i2c_driver_install(i2c_master_port, conf.mode, 0, 0, 0);
}

/*
______________________________________________________________________
 * | start | slave_addr + rd_bit  | read n-1 bytes | read 1 byte | stop |
 *
 */
/* СДЕЛАТЬ ФУНКУ ЧТЕНИЯ
static esp_err_t i2c_master_read_slave(i2c_port_t i2c_num, uint8_t *data_rd, size_t size)
{
    if (size == 0)
    {
        return ESP_OK;
    }
    i2c_cmd_handle_t cmd = i2c_cmd_link_create();
    i2c_master_start(cmd);
    i2c_master_write_byte(cmd, I2C_ADDR | I2C_MASTER_READ, ACK_CHECK_EN);
    if (size > 1)
    {
        i2c_master_read(cmd, data_rd, size - 1, ACK_VAL);
    }
    i2c_master_read_byte(cmd, data_rd + size - 1, NACK_VAL);
    i2c_master_stop(cmd);
    esp_err_t ret = i2c_master_cmd_begin(i2c_num, cmd, 1000 / portTICK_RATE_MS);
    i2c_cmd_link_delete(cmd);
    return ret;
}
*/
/*______________________
 * | start | slave_addr + wr_bit  | write n bytes +   | stop |
 *
 */
static esp_err_t i2c_master_write_comm(i2c_port_t i2c_num, uint8_t data_wr, size_t size)
{
    i2c_cmd_handle_t cmd = i2c_cmd_link_create();
    i2c_master_start(cmd);
    i2c_master_write_byte(cmd, (I2C_ADDR << 1) | I2C_MASTER_WRITE, ACK_CHECK_DIS);
    i2c_master_write_byte(cmd, COMM_MODE, ACK_CHECK_DIS);
    i2c_master_write_byte(cmd, data_wr, ACK_CHECK_DIS);
    i2c_master_stop(cmd);
    esp_err_t ret = i2c_master_cmd_begin(i2c_num, cmd, 10);
    i2c_cmd_link_delete(cmd);
    return ret;
}

static esp_err_t i2c_master_write_data(i2c_port_t i2c_num, uint8_t *data, size_t size)
{
    i2c_cmd_handle_t cmd = i2c_cmd_link_create();
    i2c_master_start(cmd);
    i2c_master_write_byte(cmd, (I2C_ADDR << 1) | I2C_MASTER_WRITE, ACK_CHECK_DIS);
    i2c_master_write_byte(cmd, DATA_MODE, ACK_CHECK_DIS);
    i2c_master_write(cmd, data, size, ACK_CHECK_DIS);
    i2c_master_stop(cmd);
    esp_err_t ret = i2c_master_cmd_begin(i2c_num, cmd, 10);
    i2c_cmd_link_delete(cmd);
    return ret;
}

static esp_err_t i2c_master_write_u8(i2c_port_t i2c_num, uint8_t data)
{
    i2c_cmd_handle_t cmd = i2c_cmd_link_create();
    i2c_master_start(cmd);
    i2c_master_write_byte(cmd, (I2C_ADDR << 1) | I2C_MASTER_WRITE, ACK_CHECK_DIS);
    i2c_master_write_byte(cmd, DATA_MODE, ACK_CHECK_DIS);
    i2c_master_write_byte(cmd, data, ACK_CHECK_DIS);
    i2c_master_stop(cmd);
    esp_err_t ret = i2c_master_cmd_begin(i2c_num, cmd, 10);
    i2c_cmd_link_delete(cmd);
    return ret;
}

/*
static esp_err_t i2c_master_write_data_byte(i2c_port_t i2c_num, uint8_t byte)
{
    i2c_cmd_handle_t cmd = i2c_cmd_link_create();
    i2c_master_start(cmd);
    i2c_master_write_byte(cmd, (I2C_ADDR << 1) | I2C_MASTER_WRITE, ACK_CHECK_DIS);
    i2c_master_write_byte(cmd, DATA_MODE, ACK_CHECK_DIS);
    i2c_master_write(cmd, data, size, ACK_CHECK_DIS);
    i2c_master_stop(cmd);
    esp_err_t ret = i2c_master_cmd_begin(i2c_num, cmd, 10);
    i2c_cmd_link_delete(cmd);
    return ret;
}
*/

// Send a byte to the command register
uint8_t display_wrcom(uint8_t byte)
{
    uint8_t ret = 0;

    // printf("send byte :%X\n", byte);

    ret = i2c_master_write_comm(I2C_NUM_0, byte, 1);

    //  printf("result send :%d\n", ret);

    return ret;
}

uint8_t display_send_data(uint8_t *buffer, size_t buff_size)
{
    uint8_t ret = 0;

    //printf("send byte :%d\n", &buffer);

    ret = i2c_master_write_data(I2C_NUM_0, buffer, buff_size);

    // printf("result send :%d\n", ret);

    return ret;
}

void display_send_u8(uint8_t byte)
{
    i2c_master_write_u8(I2C_NUM_0, byte);
}

int display_init(void)
{
    int ret = 0;

    ret = display_wrcom(0xAE); //Вылючить
    ret = display_wrcom(0x15); //Стартовая колонка
    ret = display_wrcom(0x00); //Стартовая колонка = 0
    ret = display_wrcom(0x7f); //конец 127
    ret = display_wrcom(0x75); //Установка строки
    ret = display_wrcom(0x00); //Стартовая строка = 0
    ret = display_wrcom(0x7f); //конец 127
    ret = display_wrcom(0x81); //Установка контрасности
    ret = display_wrcom(0xfe); //50% 128/255
    ret = display_wrcom(0xa0); //reemap
    ret = display_wrcom(0x51); //
    ret = display_wrcom(0xa1); //Стартовая линия
    ret = display_wrcom(0x00); //
    ret = display_wrcom(0xa2); //Отступ
    ret = display_wrcom(0x00); //
    ret = display_wrcom(0xa4); //Нормальное отображение
    ret = display_wrcom(0xa8); //MUX RATIO
    ret = display_wrcom(0x7f); //[6:0] 128MUX
    ret = display_wrcom(0x7f); //Contrast control register is set at 7Fh
    ret = display_wrcom(0xb1); //phase lenght
    ret = display_wrcom(0xf2); //
    ret = display_wrcom(0xb3); //Делитель тактовой частоты
    ret = display_wrcom(0xf2); // /////////--&&&100hz
    ret = display_wrcom(0xab); //enable input regulator
    ret = display_wrcom(0x01); //
    ret = display_wrcom(0xb6); //Set seconf Pre-charge period
    ret = display_wrcom(0x0f); //
    ret = display_wrcom(0xbc); //Set precharcge voltage
    ret = display_wrcom(0x1f); //set vcom
    ret = display_wrcom(0xbe); //Set Vcom
    ret = display_wrcom(0x07); //
    ret = display_wrcom(0xfd); //unlock comm
    ret = display_wrcom(0x12); //
    ret = display_wrcom(0xAF);
    
    return ret;
}

void set_coord(uint8_t x1, uint8_t y1, uint8_t x2, uint8_t y2) //, uint8_t x2, uint8_t y2)
{
    //TODO: проверки на результат операций и возвращаемое значение
    int res = 0;

    res = display_wrcom(0x15); //колонка
    res = display_wrcom(x1); //Начало
    res = display_wrcom(x2); //Конец
    res = display_wrcom(0x75); //столбец
    res = display_wrcom(y1);
    res = display_wrcom(y2);
}

// Обновить весь экран из буфера
void ssd1327_full_write_buff(void)
{
    set_coord(0, 0, 63, 127); //установим "курсор" в начало
    display_send_data(SSD1327_Buffer, SSD1327_BUFFER_SIZE);
}

void ssd1327_fill_all_color(SSD1327_COLOR color)
{
    for (size_t i = 0; i < sizeof(SSD1327_Buffer); i++)
        SSD1327_Buffer[i] = (color == Black) ? 0x00 : 0xFF;

    ssd1327_full_write_buff();
}

/* Привести координаты пикселей к линейному адресу */
uint16_t coords_to_addr(uint8_t x, uint8_t y)
{
    return (x / 2) + (y * 64);
}

/* координаты пикселя x,y 0-127, цвет 0-15, и вывести или буферизоровать */
void set_pix_on_buf(uint8_t x, uint8_t y, uint8_t color, bool display)
{
    uint16_t address = coords_to_addr(x, y);

    if ((x % 2) == 0)
        SSD1327_Buffer[address] = (SSD1327_Buffer[address] & 0x0f) | (color << 4);
    else
        SSD1327_Buffer[address] = (SSD1327_Buffer[address] & 0xf0) | (color);

}

void byte_to_row(uint8_t x, uint8_t y, uint8_t byte, uint8_t color)
{
    for (int i = 0; i < 8; i++)
    {
        if (byte & (1 << i))
        {
            set_pix_on_buf(x + i, y, color, true);
        }
        else
        {
           set_pix_on_buf(x + i, y, 0x00, true); 
        }
    }
}

void print_char(uint8_t x, uint8_t y, char thisChar, uint8_t color)
{
    for (size_t i = 0; i < 8; i++)
    {
        byte_to_row(x, y + i, font8x8_basic[(unsigned char)thisChar][i], color);
    }
}

void print_char16(uint8_t x, uint8_t y, char thisChar, uint8_t color) 
{
	for (size_t row = 0; row < 16; row++)
     {
		byte_to_row(x, y+row, font16x16[(unsigned char)thisChar][row*2], color);
		byte_to_row(x+8, y+row, font16x16[(unsigned char)thisChar][(row*2)+1], color);
	}
}

void print_string(uint8_t x, uint8_t y, char *str, uint8_t color)
{
    uint16_t offset = 0;

    for (; *str != '\0'; str++)
    {
        print_char(x + offset, y, *str, color);
        offset += 8;
    }
}

void print_string16(uint8_t x, uint8_t y, char *str, uint8_t color)
{
    uint16_t offset = 0;

    for (; *str != '\0'; str++)
    {
        print_char16(x + offset, y, *str, color);
        offset += 10;
    }
}

//Залить часть буфера по координатам
void ssd1327_write_part_buff(uint8_t x, uint8_t y, int font_size , size_t len)
{

    uint16_t start = coords_to_addr(x, y);

    set_coord(x/2 , y , 63, 127);//0 0 63 127

    display_send_data(&SSD1327_Buffer[start], (font_size*8)*(len + 2));
}

static void i2c_test_task(void *arg)
{

    char str_out[10] = {0};
    int temp = 0;

    if (display_init() == ESP_OK)
        printf("Display init OK\n");
    else
        printf("Error init display\n");

    ssd1327_fill_all_color(Black);
    //set_coord(0, 0, 63, 127);
    vTaskDelay(1000);

    while (1)
    {  
        sprintf(str_out, "T = %d", temp++);
        print_string(0, 10, str_out, White);
        ssd1327_write_part_buff(0, 10, 8, strlen(str_out)); //Надо писануть функция вычисления размера строки в кол-во бит
        print_string(0, 20, "Test esp32 i2c", White);
        ssd1327_write_part_buff(0, 20, 8, strlen("Test esp32 i2c"));

    }

    vTaskDelete(NULL);
}

void app_main(void)
{
    uint32_t err = 0;

    err = i2c_master_init();
    printf("i2c driver result = %d \n", err);
    xTaskCreate(i2c_test_task, "i2c_task", 1024 * 2, (void *)0, 10, NULL);
}
